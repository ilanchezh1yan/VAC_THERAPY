## CMakeLists.txt
```
# SPDX-License-Identifier: Apache-2.0

cmake_minimum_required(VERSION 3.20.0)

find_package(Zephyr REQUIRED HINTS $ENV{ZEPHYR_BASE})
project(wound_theropy)

#target_sources(app PRIVATE src/spi.c)
#target_sources(app PRIVATE src/gpio.c)
target_sources(app PRIVATE src/i2c.c)
#target_sources(app PRIVATE src/bluetooth.c)
#target_sources(app PRIVATE src/uart.c)
```

## prj.conf
```kconfig
CONFIG_SERIAL=n
CONFIG_SPI=y
CONFIG_I2C=n

CONFIG_IPM=n

CONFIG_BT=n
CONFIG_BT_HCI=n
CONFIG_BT_PERIPHERAL=n
#CONFIG_BT_DEVICE_NAME="VAC_Therapy"
```

## include/rc522.h
```c
enum Register {
	// Page 0: Command and status
	CommandReg				= 0x01 << 1,	// starts and stops command execution
	ComIEnReg				= 0x02 << 1,	// enable and disable interrupt request control bits
	DivIEnReg				= 0x03 << 1,	// enable and disable interrupt request control bits
	ComIrqReg				= 0x04 << 1,	// interrupt request bits
	DivIrqReg				= 0x05 << 1,	// interrupt request bits
	ErrorReg				= 0x06 << 1,	// error bits showing the error status of the last command executed 
	Status1Reg				= 0x07 << 1,	// communication status bits
	Status2Reg				= 0x08 << 1,	// receiver and transmitter status bits
	FIFODataReg				= 0x09 << 1,	// input and output of 64 byte FIFO buffer
	FIFOLevelReg				= 0x0A << 1,	// number of bytes stored in the FIFO buffer
	WaterLevelReg				= 0x0B << 1,	// level for FIFO underflow and overflow warning
	ControlReg				= 0x0C << 1,	// miscellaneous control registers
	BitFramingReg				= 0x0D << 1,	// adjustments for bit-oriented frames
	CollReg					= 0x0E << 1,	// bit position of the first bit-collision detected on the RF interface
	
	// Page 1: Command
	ModeReg					= 0x11 << 1,	// defines general modes for transmitting and receiving 
	TxModeReg				= 0x12 << 1,	// defines transmission data rate and framing
	RxModeReg				= 0x13 << 1,	// defines reception data rate and framing
	TxControlReg				= 0x14 << 1,	// controls the logical behavior of the antenna driver pins TX1 and TX2
	TxASKReg				= 0x15 << 1,	// controls the setting of the transmission modulation
	TxSelReg				= 0x16 << 1,	// selects the internal sources for the antenna driver
	RxSelReg				= 0x17 << 1,	// selects internal receiver settings
	RxThresholdReg				= 0x18 << 1,	// selects thresholds for the bit decoder
	DemodReg				= 0x19 << 1,	// defines demodulator settings
	MfTxReg					= 0x1C << 1,	// controls some MIFARE communication transmit parameters
	MfRxReg					= 0x1D << 1,	// controls some MIFARE communication receive parameters
	SerialSpeedReg				= 0x1F << 1,	// selects the speed of the serial UART interface
	
	// Page 2: Configuration
	CRCResultRegH				= 0x21 << 1,	// shows the MSB and LSB values of the CRC calculation
	CRCResultRegL				= 0x22 << 1,
	ModWidthReg				= 0x24 << 1,	// controls the ModWidth setting?
	RFCfgReg				= 0x26 << 1,	// configures the receiver gain
	GsNReg					= 0x27 << 1,	// selects the conductance of the antenna driver pins TX1 and TX2 for modulation 
	CWGsPReg				= 0x28 << 1,	// defines the conductance of the p-driver output during periods of no modulation
	ModGsPReg				= 0x29 << 1,	// defines the conductance of the p-driver output during periods of modulation
	TModeReg				= 0x2A << 1,	// defines settings for the internal timer
	TPrescalerReg				= 0x2B << 1,	// the lower 8 bits of the TPrescaler value. The 4 high bits are in TModeReg.
	TReloadRegH				= 0x2C << 1,	// defines the 16-bit timer reload value
	TReloadRegL				= 0x2D << 1,
	TCounterValueRegH			= 0x2E << 1,	// shows the 16-bit timer value
	TCounterValueRegL			= 0x2F << 1,
	
	// Page 3: Test Registers
	TestSel1Reg				= 0x31 << 1,	// general test signal configuration
	TestSel2Reg				= 0x32 << 1,	// general test signal configuration
	TestPinEnReg				= 0x33 << 1,	// enables pin output driver on pins D1 to D7
	TestPinValueReg				= 0x34 << 1,	// defines the values for D1 to D7 when it is used as an I/O bus
	TestBusReg				= 0x35 << 1,	// shows the status of the internal test bus
	AutoTestReg				= 0x36 << 1,	// controls the digital self-test
	VersionReg				= 0x37 << 1,	// shows the software version
	AnalogTestReg				= 0x38 << 1,	// controls the pins AUX1 and AUX2
	TestDAC1Reg				= 0x39 << 1,	// defines the test value for TestDAC1
	TestDAC2Reg				= 0x3A << 1,	// defines the test value for TestDAC2
	TestADCReg				= 0x3B << 1		// shows the value of ADC I and Q channels
};
```

## src/bluetooth.c
```c
#include <zephyr/kernel.h>
#include <zephyr/sys/printk.h>
#include <zephyr/device.h>
#include <zephyr/bluetooth/bluetooth.h>
#include <zephyr/bluetooth/uuid.h>
#include <zephyr/bluetooth/gatt.h>
#include <string.h>

#define MIN_CONNECTION_INTERVAL 8     /*1.25 ms connection interval */
#define MAX_CONNECTION_INTERVAL 8     /*1.25ms connection interval */
#define SUPERVISOR_TIMEOUT 400          /* 4s connection timeout */

static const struct bt_data ad[] = {
        BT_DATA_BYTES(BT_DATA_FLAGS, (BT_LE_AD_GENERAL | BT_LE_AD_NO_BREDR)),
    };

static const struct bt_data sd[] = {
	    BT_DATA(BT_DATA_NAME_COMPLETE, CONFIG_BT_DEVICE_NAME, sizeof(CONFIG_BT_DEVICE_NAME) - 1),
    };

static struct bt_uuid_128 custom_Read_service_uuid = BT_UUID_INIT_128(0xfb, 0x34, 0x9b, 0x5f, 0x80, 0x00, 0x00, 0x80,
                                              0x00, 0x10, 0x00, 0x00, 0xe0, 0xff, 0x00, 0x00);  

static struct bt_uuid_128 live_graph_uuid = BT_UUID_INIT_128(0xfb, 0x34, 0x9b, 0x5f, 0x80, 0x00, 0x00, 0x80,
                                                                   0x00, 0x10, 0x00, 0x00, 0xe1, 0xff, 0x00, 0x00);    
static uint8_t data_packet[12] = "hello_world";                                                         

void CCC_cb(const struct bt_gatt_attr *attr, uint16_t value)
{
   bool data = value ==  BT_GATT_CCC_NOTIFY;
}

BT_GATT_SERVICE_DEFINE(custom_service,
    BT_GATT_PRIMARY_SERVICE(&custom_Read_service_uuid),
    BT_GATT_CHARACTERISTIC(&live_graph_uuid.uuid,
                           BT_GATT_CHRC_NOTIFY,
                           BT_GATT_PERM_NONE,
                           NULL, NULL, data_packet),
    BT_GATT_CCC(CCC_cb, BT_GATT_PERM_READ | BT_GATT_PERM_WRITE),
);

#if 1
void connected(struct bt_conn *conn, uint8_t err)
{
	struct bt_le_conn_param *param = BT_LE_CONN_PARAM(MIN_CONNECTION_INTERVAL, MAX_CONNECTION_INTERVAL , 0, SUPERVISOR_TIMEOUT);
	bt_conn_le_param_update(conn, param);
}

BT_CONN_CB_DEFINE(conn_callbacks) = {
	.connected = connected,
};
#endif        

int ble_init (void) 
{
    int err;
    
    err = bt_enable(NULL);
    if (err) {
	    return 1;
    }

    err = bt_le_adv_start(BT_LE_ADV_CONN_FAST_1, ad, ARRAY_SIZE(ad), sd, ARRAY_SIZE(sd));
    if (err) {
	    return 1;
    }
    
    return 0;

}

int BT_send(unsigned char * RX_data)
{
	int ret;

	memcpy(data_packet, RX_data, 12);
	k_sleep(K_USEC(1000));
	ret = bt_gatt_notify(NULL, &custom_service.attrs[1], data_packet, sizeof(data_packet));
	if(ret) {
		printk("send error ret : %d", ret);
		 return 1;
	}
	
	return 0;
}

#if 1

int main(void)
{
	int ret;
	
	ret = ble_init();
	if (ret) {
	    printk("init err : %d\n", ret);
	    return ret;
    	}
	printk("ble init\n");
	ret = BT_send(data_packet);
	if (ret) {
	    return ret;
    	}
	
	return 0;
}

#endif
                                                 
```

## src/dac.c
```c
#include <stdio.h>
#include <zephyr/kernel.h>
#include <zephyr/device.h>
#include <zephyr/drivers/dac.h>

#define DAC_CHANNEL_1  0
#define DAC_RESOLUTION 8 

const struct device *dac_dev;

struct dac_channel_cfg dac_cfg = {
	.channel_id = DAC_CHANNEL_1,
	.resolution = DAC_RESOLUTION,
};

int DAC_init(void)
{
	int ret;

	dac_dev = DEVICE_DT_GET(DT_NODELABEL(dac));
	if (!device_is_ready(dac_dev)) {
		return 0;
	}

	ret = dac_channel_setup(dac_dev, &dac_cfg);
	if (ret) {
		return ret;
	}
}

int motor_speed(unsigned char dac_data)
{
	ret = dac_write_value(dac_dev, DAC_CHANNEL_1, dac_data);
	if (ret) {
		return ret;
	}
}

int main(void)
{
	DAC_init();
	motor_speed(210);
	
	
}
```

## src/gpio.c
```c
#include <zephyr/kernel.h>
#include <zephyr/device.h>
#include <zephyr/drivers/gpio.h>

#define GPIO_PIN 5

const struct device *gpio_dev;

static struct gpio_callback gpio_cb;
static volatile uint32_t edge_count = 0;

void gpio_callback_handler(const struct device *dev, struct gpio_callback *cb, uint32_t pins)
{
    edge_count++;
}

int GPIO_init(void)
{
    int ret;

    gpio_dev = DEVICE_DT_GET(DT_NODELABEL(gpio_0));

    ret = device_is_ready(gpio_dev);
    if(!ret) {
	printk("device is not ready");
        return ret;
    }

    ret = gpio_pin_configure(gpio_dev, GPIO_PIN, GPIO_INPUT | GPIO_INT_EDGE_BOTH);
    if (ret) {
        return ret;
    }
    return 0;
}

int32_t cs_status(uint8_t pin, uint8_t status)
{
	int32_t ret;
	ret = gpio_pin_set(gpio_dev, pin, status);
	if(ret) {
		return ret;
	}
	return 0;
}

#if 0
int main(void) {
	int ret;
	uint32_t count_snapshot = 0;
    	uint32_t frequency = 0;

	ret = GPIO_init();
	if(ret) {
		return ret;
	}
	
	gpio_init_callback(&gpio_cb, gpio_callback_handler, BIT(GPIO_PIN));
    	ret = gpio_add_callback(gpio_dev, &gpio_cb);
    	if (ret < 0) {
        	printk("Failed to add GPIO callback\n");
        	return ret;
    	}

    	ret = gpio_pin_interrupt_configure(gpio_dev, GPIO_PIN, GPIO_INT_EDGE_BOTH);
    	if (ret < 0) {
        	printk("Failed to configure GPIO interrupt\n");
        	return ret;
	}

    	while(1){
		k_sleep(K_SECONDS(1));
        
        	count_snapshot = edge_count;
        	edge_count = 0;
   
        	frequency = count_snapshot;
        	printk("Frequency: %u Hz\n", frequency);
	}
}
#endif
```
